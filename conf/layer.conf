## conf/layer.conf
```bitbake
# We have a conf and classes directory, add to BBPATH
BBPATH .= ":${LAYERDIR}"

# We have recipes-* directories, add to BBFILES
BBFILES += "${LAYERDIR}/recipes-*/*/*.bb \
            ${LAYERDIR}/recipes-*/*/*.bbappend"

BBFILE_COLLECTIONS += "layers/meta-alexa"
BBFILE_PATTERN_layers/meta-alexa = "^${LAYERDIR}/"
BBFILE_PRIORITY_layers/meta-alexa = "6"

LICENSE_PATH += "${LAYERDIR}/common/custom-licenses"
```
